## CMakeLists.txt
```
cmake_minimum_required(VERSION 3.20.0)
find_package(Zephyr REQUIRED HINTS $ENV{ZEPHYR_BASE})
project(can_smoke_test)

# This target exercises raw CAN without radio or protobuf initialization.
target_sources(app PRIVATE src/main.cpp ../antenna_app/src/can_handler.cpp)
```

## Kconfig
```
mainmenu "DANT raw CAN test"

source "Kconfig.zephyr"

menu "DANT options"

choice DANT_NODE_ROLE
	prompt "DANT node role"
	default DANT_NODE_A

config DANT_NODE_A
	bool "Node A"

config DANT_NODE_B
	bool "Node B"

endchoice

config DANT_TX_PERIOD_MS
	int "TX period in milliseconds"
	default 1000
	range 10 60000

endmenu
```

## prj.conf
```kconfig
CONFIG_CAN=y
CONFIG_SERIAL=y
CONFIG_CONSOLE=y
CONFIG_UART_CONSOLE=y
CONFIG_PRINTK=y
CONFIG_CPP=y
CONFIG_MAIN_STACK_SIZE=1024
```

## node_a.conf
```kconfig
CONFIG_DANT_NODE_A=y
```

## node_b.conf
```kconfig
CONFIG_DANT_NODE_B=y
```

## boards/nucleo_f103rb.overlay
```dts
/* Nucleo only: these pins are deployment outputs on the DANT PCB. */
/ { chosen { zephyr,canbus = &can1; }; };
&can1 {
    status = "okay";
    pinctrl-0 = <&can_rx_pa11 &can_tx_pa12>;
    pinctrl-names = "default";
    bitrate = <50000>;
    sample-point = <750>;
};
```

## src/main.cpp
```c
#include <zephyr/kernel.h>

/**
 * @brief Leave CAN processing to the automatically started worker.
 * @return Zero.
 */
int main() { return 0; }
```
